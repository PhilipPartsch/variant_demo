## configs/bus_bev_lfp_eu_defconfig
```kconfig
CONFIG_VEHICLE__TYPE__BUS=y
CONFIG_POWERTRAIN__TYPE__BEV=y
CONFIG_BMS__CHEMISTRY__LFP=y
CONFIG_HV__CLASS__V400=y
CONFIG_CHARGING__PANTOGRAPH=y
CONFIG_MARKET__REGION__EU=y
```

## configs/truck_bev_lfp_na_defconfig
```kconfig
CONFIG_VEHICLE__TYPE__TRUCK=y
CONFIG_POWERTRAIN__TYPE__BEV=y
CONFIG_BMS__CHEMISTRY__LFP=y
CONFIG_HV__VOLTAGE__V800=y
# CONFIG_CHARGING__MCS is not set
CONFIG_MARKET__REGION__NA=y
```

## configs/truck_bev_nmc_eu_defconfig
```kconfig
CONFIG_VEHICLE__TYPE__TRUCK=y
CONFIG_POWERTRAIN__TYPE__BEV=y
CONFIG_BMS__CHEMISTRY__NMC=y
CONFIG_HV__CLASS__V800=y
CONFIG_CHARGING__MCS=y
CONFIG_MARKET__REGION__EU=y
```

## configs/truck_diesel_eu_defconfig
```kconfig
CONFIG_VEHICLE__TYPE__TRUCK=y
CONFIG_POWERTRAIN__TYPE__DIESEL=y
CONFIG_MARKET__REGION__EU=y
```
